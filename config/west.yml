## config/west.yml
```yaml
manifest:
  remotes:
    - name: zmkfirmware
      url-base: https://github.com/petejohanson/     # <--- CHANGE REPO
  projects:
    - name: zmk
      remote: zmkfirmware
      revision: feat/pointers-move-scroll                   # <--- CHANGE REVISION
      import: app/west.yml
  self:
    path: config
```
